## config/west.yml
```yaml
manifest:
  remotes:
    - name: zmkfirmware
      url-base: https://github.com/olliekillen
  projects:
    - name: zmk
      remote: zmkfirmware
      revision: stephen/split-encoder
      import: app/west.yml
  self: 
    path: config
```
